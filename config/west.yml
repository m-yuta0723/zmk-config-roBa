## config/west.yml
```yaml
manifest:
  remotes:
    - name: cormoran
      url-base: https://github.com/cormoran
    - name: badjeff
      url-base: https://github.com/badjeff
    - name: m-yuta0723
      url-base: https://github.com/m-yuta0723
  projects:
    # ZMK core: DYA Studio 用 RPC サブシステムを含む cormoran fork
    - name: zmk
      remote: cormoran
      revision: v0.3-branch+dya
      import: app/west.yml

    # PMW3610 driver: DYA Studio (runtime-input-processor) が要求する
    # cpi / evt-type / x-input-code / y-input-code の devicetree property に対応した版
    - name: zmk-pmw3610-driver
      remote: badjeff
      revision: zmk-0.3

    # DYA Studio モジュール（すべて cormoran リポジトリ）
    - name: zmk-module-ble-management
      remote: cormoran
      revision: 851661cd21f2aded8ec649da86e01a207dc4b973
    - name: zmk-module-settings-rpc
      remote: cormoran
      revision: main
    - name: zmk-module-runtime-input-processor
      remote: cormoran
      revision: dbf92f764de8b6ffd60bf5850514302875fe2570
    - name: zmk-behavior-runtime-sensor-rotate
      remote: cormoran
      revision: main

    # マクロ&コンボ タブ用のサブシステム。
    # 両モジュールが共通で依存する設定ストレージ。import: true に頼らず
    # 明示的に1回だけ書いて、二重定義を避ける。
    #
    # 上流(cormoran/main)はKconfigに configdefault を使っており、
    # ZMK v0.3系同梱のZephyrが解析できずビルドが落ちる。
    # その1ブロックだけを外した派生を参照する。
    # 代替として下の roBa_R.conf で CONFIG_MAIN_STACK_SIZE=2048 を明示している。
    - name: zmk-feature-custom-settings
      remote: m-yuta0723
      revision: v0.3-compat
    - name: zmk-feature-runtime-macro
      remote: cormoran
      revision: main
    - name: zmk-feature-runtime-combo
      remote: cormoran
      revision: main
  self:
    path: config
```
